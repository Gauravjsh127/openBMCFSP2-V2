## meta-openbmc-bsp/meta-ibm/meta-fsp2/conf/machine/fsp2.conf
```bitbake
MACHINE = "fsp2"
KERNEL_DEVICETREE = "fsp2.dtb"
KBUILD_DEFCONFIG = "44x/fsp2_defconfig"

require conf/machine/include/fsp2.inc

#dummy uboot settings
UBOOT_MACHINE_fsp2 = "mpc8308_p1m_defconfig"


MACHINE_FEATURES = "keyboard pci ext2 ext3 serial"
MACHINE_EXTRA_RRECOMMENDS = " kernel-modules"
UBOOT_ENTRYPOINT = "0x01400000"
SERIAL_CONSOLE = "115200 ttyS0"

IMAGE_FSTYPES ?= "cpio.gz"
```

## meta-openbmc-machines/meta-openpower/meta-ibm/meta-system-q-fsp2-x86/conf/layer.conf
```bitbake
# We have a conf and classes directory, add to BBPATH
BBPATH .= ":${LAYERDIR}"


# We have recipes-* directories, add to BBFILES
BBFILES += "${LAYERDIR}/recipes-*/*/*.bb \
            ${LAYERDIR}/recipes-*/*/*.bbappend"

BBFILE_COLLECTIONS += "system-q-fsp2-x86"
BBFILE_PATTERN_system-q-fsp2-x86 = ""


LAYERSERIES_COMPAT_system-q-fsp2-x86 = "sumo"
```

## meta-openbmc-machines/meta-openpower/meta-ibm/meta-system-q-fsp2/conf/layer.conf
```bitbake
# We have a conf and classes directory, add to BBPATH
BBPATH .= ":${LAYERDIR}"

BBFILE_COLLECTIONS += "ibm-system-q-fsp2"
BBFILE_PATTERN_ibm-system-q-fsp2 = ""
```

## meta-openbmc-machines/meta-openpower/meta-ibm/meta-z-fsp2-x86/conf/bblayers.conf.sample
```bitbake
# LAYER_CONF_VERSION is increased each time build/conf/bblayers.conf
# changes incompatibly
LCONF_VERSION = "6"

BBPATH = "${TOPDIR}"
BBFILES ?= ""

BBLAYERS ?= " \
  ##OEROOT##/meta \
  ##OEROOT##/meta-poky \
  ##OEROOT##/import-layers/meta-openembedded/meta-filesystems/   \
  ##OEROOT##/import-layers/meta-openembedded/meta-oe \
  ##OEROOT##/import-layers/meta-openembedded/meta-networking \
  ##OEROOT##/import-layers/meta-openembedded/meta-python \
  ##OEROOT##/import-layers/meta-openembedded/meta-webserver \
  ##OEROOT##/import-layers/meta-virtualization \
  ##OEROOT##/meta-phosphor \
  ##OEROOT##/meta-openbmc-bsp/meta-ibm/meta-fsp2 \
  ##OEROOT##/meta-openbmc-machines/meta-openpower \
  ##OEROOT##/meta-openbmc-machines/meta-openpower/meta-ibm \
  ##OEROOT##/meta-openbmc-machines/meta-openpower/meta-ibm/meta-z-fsp2-x86 \
  ##OEROOT##/meta-openbmc-bsp/meta-ibm/meta-fsp2 \
  ##OEROOT##/meta-openbmc-bsp/meta-ibm/meta-fsp2-ibm-internal/meta-fsp2-drivers \
  ##OEROOT##/meta-openbmc-bsp/meta-ibm/meta-fsp2-ibm-internal/meta-fsp2-adals \
  ##OEROOT##/meta-openbmc-bsp/meta-ibm/meta-fsp2-ibm-internal/meta-fsp2-apps \  
  ##OEROOT##/meta-openbmc-bsp/meta-ibm/meta-fsp2-ibm-internal/meta-fsp2-boot \ 
  "
BBLAYERS_NON_REMOVABLE ?= " \
  ##OEROOT##/meta \
  ##OEROOT##/meta-poky \
  ##OEROOT##/import-layers/meta-openembedded/meta-oe \
  ##OEROOT##/import-layers/meta-openembedded/meta-networking \
  ##OEROOT##/import-layers/meta-openembedded/meta-python \
  ##OEROOT##/import-layers/meta-virtualization \
  "
```

## meta-openbmc-machines/meta-openpower/meta-ibm/meta-z-fsp2-x86/conf/layer.conf
```bitbake
# We have a conf and classes directory, add to BBPATH
BBPATH .= ":${LAYERDIR}"


# We have recipes-* directories, add to BBFILES
BBFILES += "${LAYERDIR}/recipes-*/*/*.bb \
            ${LAYERDIR}/recipes-*/*/*.bbappend"


BBFILE_COLLECTIONS += "ibm-z-fsp2-x86"
BBFILE_PATTERN_ibm-z-fsp2-x86 = ""
```

## meta-openbmc-machines/meta-openpower/meta-ibm/meta-z-qemu-ppc/conf/bblayers.conf.sample
```bitbake
# LAYER_CONF_VERSION is increased each time build/conf/bblayers.conf
# changes incompatibly
LCONF_VERSION = "6"

BBPATH = "${TOPDIR}"
BBFILES ?= ""

BBLAYERS ?= " \
  ##OEROOT##/meta \
  ##OEROOT##/meta-poky \
  ##OEROOT##/meta-openbmc-bsp/meta-ibm/meta-fsp2 \
  ##OEROOT##/import-layers/meta-openembedded/meta-filesystems/   \
  ##OEROOT##/import-layers/meta-openembedded/meta-oe \
  ##OEROOT##/import-layers/meta-openembedded/meta-networking \
  ##OEROOT##/import-layers/meta-openembedded/meta-python \
  ##OEROOT##/import-layers/meta-openembedded/meta-webserver \
  ##OEROOT##/import-layers/meta-virtualization \
  ##OEROOT##/meta-openbmc-machines/meta-openpower/meta-ibm/meta-z-qemu-ppc \
  ##OEROOT##/meta-phosphor \
  "
BBLAYERS_NON_REMOVABLE ?= " \
  ##OEROOT##/meta \
  ##OEROOT##/meta-poky \
  ##OEROOT##/import-layers/meta-openembedded/meta-oe \
  ##OEROOT##/import-layers/meta-openembedded/meta-networking \
  ##OEROOT##/import-layers/meta-openembedded/meta-python \
  "
```

## meta-openbmc-machines/meta-openpower/meta-ibm/meta-z-qemu-ppc/conf/layer.conf
```bitbake
# We have a conf and classes directory, add to BBPATH
BBPATH .= ":${LAYERDIR}"

# We have recipes-* directories, add to BBFILES
BBFILES += "${LAYERDIR}/recipes-*/*/*.bb \
            ${LAYERDIR}/recipes-*/*/*.bbappend"
BBFILE_COLLECTIONS += "ibm-z-qemu-ppc"
BBFILE_PATTERN_ibm-z-qemu-ppc = ""


LAYERSERIES_COMPAT_ibm-z-qemu-ppc = "sumo"
```

## meta-openbmc-machines/meta-openpower/meta-ibm/meta-z-qemu-ppc/conf/local.conf.sample
```bitbake
MACHINE ??= "qemuppc"
DISTRO ?= "openbmc-phosphor"
PACKAGE_CLASSES ?= "package_rpm"
SANITY_TESTED_DISTROS_append ?= " *"
EXTRA_IMAGE_FEATURES = "debug-tweaks"
USER_CLASSES ?= "buildstats image-mklibs image-prelink"
PATCHRESOLVE = "noop"
BB_DISKMON_DIRS = "\
    STOPTASKS,${TMPDIR},1G,100K \
    STOPTASKS,${DL_DIR},1G,100K \
    STOPTASKS,${SSTATE_DIR},1G,100K \
    STOPTASKS,/tmp,100M,100K \
    ABORT,${TMPDIR},100M,1K \
    ABORT,${DL_DIR},100M,1K \
    ABORT,${SSTATE_DIR},100M,1K \
    ABORT,/tmp,10M,1K"
CONF_VERSION = "1"
INHERIT += "extrausers"
BB_NUMBER_THREADS = '32'
PARALLEL_MAKE = '-j 32'


#PREFERRED_PROVIDER_virtual/kernel ?= "linux-fsp2"


DISTRO_FEATURES_LIBC = "ipv6 libc-backtrace libc-big-macros libc-bsd libc-cxx-tests libc-catgets libc-charsets libc-crypt \
               libc-crypt-ufc libc-db-aliases libc-envz libc-fcvt libc-fmtmsg libc-fstab libc-ftraverse \
               libc-getlogin libc-idn libc-inet libc-inet-anl libc-libm libc-locales libc-locale-code \
               libc-memusage libc-nis libc-nsswitch libc-rcmd libc-rtld-debug libc-spawn libc-streams libc-sunrpc \
               libc-utmp libc-utmpx libc-wordexp libc-posix-clang-wchar libc-posix-regexp libc-posix-regexp-glibc \
               libc-posix-wchar-io"

################ openBMC packages ############################################

IMAGE_INSTALL_append += "mosquitto mosquitto-dev "

IMAGE_INSTALL_append += "mosquitto-clients"

IMAGE_INSTALL_append += " grpc grpc-dev grpc-dbg "

IMAGE_INSTALL_append += " zeromq zeromq-dev zeromq-dbg "

IMAGE_INSTALL_append += " sqlite3 sqlite3-dbg "

IMAGE_INSTALL_append += " fuse fuse-dev fuse-dbg  "

IMAGE_INSTALL_append += " libtirpc libtirpc-dev libtirpc-dbg "

IMAGE_INSTALL_append += "rpcbind rpcbind-dev rpcbind-dbg "

IMAGE_INSTALL_append = " kernel-modules "

EXTRA_IMAGE_FEATURES += " tools-debug"

IMAGE_INSTALL_append +=" libatomic libatomic procps "

IMAGE_INSTALL_append += " libstdc++ "

IMAGE_INSTALL_append += " kmod kmod-dbg rpm rpm-dbg "

IMAGE_INSTALL_append += " makedumpfile makedumpfile-dev makedumpfile-dbg "

IMAGE_INSTALL_append += " openldap openldap-dev lua acl   "

IMAGE_INSTALL_append += " libidn gmp nettle libcap libcap-dbg "

IMAGE_INSTALL_append += " libgpg-error libgpg-error-dbg libgcrypt  libgcrypt-dbg "

#IMAGE_INSTALL_append += " libpam pam-plugin-succeed-if pam-plugin-access libpam-dbg "

IMAGE_INSTALL_append += " net-snmp net-snmp-dev net-snmp-dbg "

IMAGE_INSTALL_append += "openssh openssh-dev openssh-dbg "

IMAGE_INSTALL_append += "util-linux util-linux-dev util-linux-dbg "

IMAGE_INSTALL_append += " tcpdump tcpdump-dev tcpdump-dbg "

IMAGE_INSTALL_append += " pciutils pciutils-dev pciutils-dbg "

IMAGE_INSTALL_append += "net-tools net-tools-dev net-tools-dbg "

IMAGE_INSTALL_append += "krb5 krb5-dev krb5-dbg "

IMAGE_INSTALL_append += "xz xz-dev xz-dbg "

IMAGE_INSTALL_append += "lua lua-dev lua-dbg "

IMAGE_INSTALL_append += "libbz2 "

IMAGE_INSTALL_append += "elfutils elfutils-dev elfutils-dbg "

IMAGE_INSTALL_append += "libcap-ng libcap-ng-dev libcap-ng-dbg "

IMAGE_INSTALL_append += "libxml2 libxml2-dbg liburcu liburcu-dbg "

IMAGE_INSTALL_append += "audit audit-dev audit-dbg "

IMAGE_INSTALL_append += "ifenslave ethtool kexec-tools kexec-tools-dbg "

IMAGE_INSTALL_append += "udev "

IMAGE_INSTALL_append += "trace-cmd trace-cmd-dbg "

################ Debug packages ############################################


IMAGE_INSTALL_append += "glibc-dbg " 

IMAGE_INSTALL_append +="lttng-ust "

IMAGE_INSTALL_append +="babeltrace babeltrace-dev"

IMAGE_INSTALL_append +="lttng-tools lttng-tools-dev "

IMAGE_INSTALL_append +="lttng-modules lttng-modules-dev "




#
# Qemu configuration
#
# By default qemu will build with a builtin VNC server where graphical output can be
# seen. The two lines below enable the SDL backend too. By default libsdl2-native will
# be built, if you want to use your host's libSDL instead of the minimal libsdl built
# by libsdl2-native then uncomment the ASSUME_PROVIDED line below.
PACKAGECONFIG_append_pn-qemu-native = " sdl"
PACKAGECONFIG_append_pn-nativesdk-qemu = " sdl"
```
